#include "oled.h"

//12*12 ASCII字符集点阵
const unsigned char asc2_1206[95][12]=
{
    {0x00,0x00,0x00,0x00,0x00,0x00,0x00,0x00,0x00,0x00,0x00,0x00},/*" ",0*/
    {0x00,0x00,0x00,0x00,0x3F,0x40,0x00,0x00,0x00,0x00,0x00,0x00},/*"!",1*/
    {0x00,0x00,0x30,0x00,0x40,0x00,0x30,0x00,0x40,0x00,0x00,0x00},/*""",2*/
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    {0x40,0x00,0x80,0x00,0x40,0x00,0x20,0x00,0x20,0x00,0x40,0x00},/*"~",94*/
};
//16*16 ASCII字符集点阵
const unsigned char asc2_1608[95][16]=
{
    {0x00,0x00,0x00,0x00,0x00,0x00,0x00,0x00,0x00,0x00,0x00,0x00,0x00,0x00,0x00,0x00},/*" ",0*/
    {0x00,0x00,0x00,0x00,0x00,0x00,0x1F,0xCC,0x00,0x0C,0x00,0x00,0x00,0x00,0x00,0x00},/*"!",1*/
    {0x00,0x00,0x08,0x00,0x30,0x00,0x60,0x00,0x08,0x00,0x30,0x00,0x60,0x00,0x00,0x00},/*""",2*/
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    {0x00,0x00,0x60,0x00,0x80,0x00,0x80,0x00,0x40,0x00,0x40,0x00,0x20,0x00,0x20,0x00},/*"~",94*/
};
//24*24 ASICII字符集点阵
const unsigned char asc2_2412[95][36]=
{
    {0x00,0x00,0x00,0x00,0x00,0x00,0x00,0x00,0x00,0x00,0x00,0x00,0x00,0x00,0x00,0x00,0x00,0x00,0x00,0x00,0x00,0x00,0x00,0x00,0x00,0x00,0x00,0x00,0x00,0x00,0x00,0x00,0x00,0x00,0x00,0x00},/*" ",0*/
    {0x00,0x00,0x00,0x00,0x00,0x00,0x00,0x00,0x00,0x00,0x00,0x00,0x00,0x00,0x00,0x0F,0x80,0x38,0x0F,0xFE,0x38,0x0F,0x80,0x38,0x00,0x00,0x00,0x00,0x00,0x00,0x00,0x00,0x00,0x00,0x00,0x00},/*"!",1*/
    {0x00,0x00,0x00,0x00,0x00,0x00,0x01,0x00,0x00,0x06,0x00,0x00,0x0C,0x00,0x00,0x38,0x00,0x00,0x31,0x00,0x00,0x06,0x00,0x00,0x0C,0x00,0x00,0x38,0x00,0x00,0x30,0x00,0x00,0x00,0x00,0x00},/*""",2*/
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    {0x00,0x00,0x00,0x18,0x00,0x00,0x60,0x00,0x00,0x40,0x00,0x00,0x40,0x00,0x00,0x20,0x00,0x00,0x10,0x00,0x00,0x08,0x00,0x00,0x04,0x00,0x00,0x04,0x00,0x00,0x0C,0x00,0x00,0x10,0x00,0x00},/*"~",94*/
};

//#include "spi.h"

//OLED的显存
//存放格式如下.
//[0]0 1 2 3 ... 127
//[1]0 1 2 3 ... 127
//[2]0 1 2 3 ... 127
//[3]0 1 2 3 ... 127
//[4]0 1 2 3 ... 127
//[5]0 1 2 3 ... 127
//[6]0 1 2 3 ... 127
//[7]0 1 2 3 ... 127
uint8_t OLED_GRAM[128][8];

//更新显存到LCD
void OLED_Refresh_Gram(void)
{
    uint8_t i,n;
    for(i=0; i<8; i++)
    {
        OLED_WR_Byte (0xb0+i,OLED_CMD);    //设置页地址（0~7）
        OLED_WR_Byte (0x00,OLED_CMD);      //设置显示位置—列低地址
        OLED_WR_Byte (0x10,OLED_CMD);      //设置显示位置—列高地址
        for(n=0; n<128; n++)OLED_WR_Byte(OLED_GRAM[n][i],OLED_DATA);
    }
}
//extern SPI_HandleTypeDef hspi1;
//向SSD1306写入一个字节。
//dat:要写入的数据/命令
//cmd:数据/命令标志 0,表示命令;1,表示数据;
void OLED_WR_Byte(uint8_t dat,uint8_t cmd)
{
    #define OLED_D0_GPIO_Port GPIOB
    #define OLED_D1_GPIO_Port GPIOB
    #define OLED_D0_Pin GPIO_PIN_3
    #define OLED_D1_Pin GPIO_PIN_5
    uint8_t i;
    if(cmd) //写命令
    {
        HAL_GPIO_WritePin(OLED_DC_GPIO_Port,OLED_DC_Pin,GPIO_PIN_SET);
    }
    else
    {
        HAL_GPIO_WritePin(OLED_DC_GPIO_Port,OLED_DC_Pin,GPIO_PIN_RESET);
    }
    HAL_GPIO_WritePin(OLED_CS_GPIO_Port,OLED_CS_Pin,GPIO_PIN_RESET);
    for(i=0; i<8; i++)
    {
        HAL_GPIO_WritePin(OLED_D0_GPIO_Port,OLED_D0_Pin,GPIO_PIN_RESET);
        if(dat&0x80)HAL_GPIO_WritePin(OLED_D1_GPIO_Port,OLED_D1_Pin,GPIO_PIN_SET);
        else HAL_GPIO_WritePin(OLED_D1_GPIO_Port,OLED_D1_Pin,GPIO_PIN_RESET);
        HAL_GPIO_WritePin(OLED_D0_GPIO_Port,OLED_D0_Pin,GPIO_PIN_SET);;
        dat<<=1;
    }
//    i = dat;
//    HAL_SPI_Transmit(&hspi1,&dat,1,0xFF);
    HAL_GPIO_WritePin(OLED_CS_GPIO_Port,OLED_CS_Pin,GPIO_PIN_SET);
    HAL_GPIO_WritePin(OLED_DC_GPIO_Port,OLED_DC_Pin,GPIO_PIN_SET);
}

//开启OLED显示
void OLED_Display_On(void)
{
    OLED_WR_Byte(0X8D,OLED_CMD);  //SET DCDC命令
    OLED_WR_Byte(0X14,OLED_CMD);  //DCDC ON
    OLED_WR_Byte(0XAF,OLED_CMD);  //DISPLAY ON
}
//关闭OLED显示
void OLED_Display_Off(void)
{
    OLED_WR_Byte(0X8D,OLED_CMD);  //SET DCDC命令
    OLED_WR_Byte(0X10,OLED_CMD);  //DCDC OFF
    OLED_WR_Byte(0XAE,OLED_CMD);  //DISPLAY OFF
}
//清屏函数,清完屏,整个屏幕是黑色的!和没点亮一样!!!
void OLED_Clear(void)
{
    uint8_t i,n;
    for(i=0; i<8; i++)for(n=0; n<128; n++)OLED_GRAM[n][i]=0X00;
    OLED_Refresh_Gram();//更新显示
}
//画点
//x:0~127
//y:0~63
//t:1 填充 0,清空
void OLED_DrawPoint(uint8_t x,uint8_t y,uint8_t t)
{
    uint8_t pos,bx,temp=0;
    if(x>127||y>63)return;//超出范围了.
    pos=7-y/8;
    bx=y%8;
    temp=1<<(7-bx);
    if(t)OLED_GRAM[x][pos]|=temp;
    else OLED_GRAM[x][pos]&=~temp;
}
//x1,y1,x2,y2 填充区域的对角坐标
//确保x1<=x2;y1<=y2 0<=x1<=127 0<=y1<=63
//dot:0,清空;1,填充
void OLED_Fill(uint8_t x1,uint8_t y1,uint8_t x2,uint8_t y2,uint8_t dot)
{
    uint8_t x,y;
    for(x=x1; x<=x2; x++)
    {
        for(y=y1; y<=y2; y++)OLED_DrawPoint(x,y,dot);
    }
}
//在指定位置显示一个字符,包括部分字符
//x:0~127
//y:0~63
//mode:0,反白显示;1,正常显示
//size:选择字体 12/16/24
void OLED_ShowChar(uint8_t x,uint8_t y,char chr,uint8_t size,uint8_t mode)
{
    uint8_t temp,t,t1;
    uint8_t y0=y;
    uint8_t csize=(size/8+((size%8)?1:0))*(size/2); //得到字体一个字符对应点阵集所占的字节数
    chr=chr-' ';//得到偏移后的值
    for(t=0; t<csize; t++)
    {
        if(size==12)temp=asc2_1206[chr][t];         //调用1206字体
        else if(size==16)temp=asc2_1608[chr][t];    //调用1608字体
        else if(size==24)temp=asc2_2412[chr][t];    //调用2412字体
        else return;    //没有的字库
        for(t1=0; t1<8; t1++)
        {
            if(temp&0x80)OLED_DrawPoint(x,y,mode);
            else OLED_DrawPoint(x,y,!mode);
            temp<<=1;
            y++;
            if((y-y0)==size)
            {
                y=y0;
                x++;
                break;
            }
        }
    }
}
//m^n函数
uint32_t mypow(uint8_t m,uint8_t n)
{
    uint32_t result=1;
    while(n--)result*=m;
    return result;
}
//显示2个数字
//x,y :起点坐标
//len :数字的位数
//size:字体大小
//mode:模式	0,填充模式;1,叠加模式
//num:数值(0~4294967295);
void OLED_ShowNum(uint8_t x,uint8_t y,uint32_t num,uint8_t len,uint8_t size)
{
    uint8_t t,temp;
    uint8_t enshow=0;
    for(t=0; t<len; t++)
    {
        temp=(num/mypow(10,len-t-1))%10;
        if(enshow==0&&t<(len-1))
        {
            if(temp==0)
            {
                OLED_ShowChar(x+(size/2)*t,y,' ',size,1);
                continue;
            } else enshow=1;

        }
        OLED_ShowChar(x+(size/2)*t,y,temp+'0',size,1);
    }
}
//显示字符串
//x,y:起点坐标
//size:字体大小
//*p:字符串起始地址
void OLED_ShowString(uint8_t x,uint8_t y,const char *p,uint8_t size)
{
    while((*p<='~')&&(*p>=' '))//判断是不是非法字符!
    {
        if(x>(128-(size/2))) {
            x=0;
            y+=size;
        }
        if(y>(64-size)) {
            y=x=0;
            OLED_Clear();
        }
        OLED_ShowChar(x,y,*p,size,1);
        x+=size/2;
        p++;
    }

}
//初始化SSD1306
void OLED_Init(void)
{
    //使用4线SPI 串口模式
    HAL_GPIO_WritePin(OLED_CS_GPIO_Port,OLED_CS_Pin,GPIO_PIN_SET);
    HAL_GPIO_WritePin(OLED_DC_GPIO_Port,OLED_DC_Pin,GPIO_PIN_SET);

    HAL_GPIO_WritePin(OLED_RST_GPIO_Port,OLED_RST_Pin,GPIO_PIN_RESET);
    HAL_Delay(10);
    HAL_GPIO_WritePin(OLED_RST_GPIO_Port,OLED_RST_Pin,GPIO_PIN_SET);
    HAL_Delay(100);

    OLED_WR_Byte(0xAE,OLED_CMD); //关闭显示
    OLED_WR_Byte(0xD5,OLED_CMD); //设置时钟分频因子,震荡频率
    OLED_WR_Byte(80,OLED_CMD);   //[3:0],分频因子;[7:4],震荡频率
    OLED_WR_Byte(0xA8,OLED_CMD); //设置驱动路数
    OLED_WR_Byte(0X3F,OLED_CMD); //默认0X3F(1/64)
    OLED_WR_Byte(0xD3,OLED_CMD); //设置显示偏移
    OLED_WR_Byte(0X00,OLED_CMD); //默认为0

    OLED_WR_Byte(0x40,OLED_CMD); //设置显示开始行 [5:0],行数.

    OLED_WR_Byte(0x8D,OLED_CMD); //电荷泵设置
    OLED_WR_Byte(0x14,OLED_CMD); //bit2，开启/关闭
    OLED_WR_Byte(0x20,OLED_CMD); //设置内存地址模式
    OLED_WR_Byte(0x02,OLED_CMD); //[1:0],00，列地址模式;01，行地址模式;10,页地址模式;默认10;
    OLED_WR_Byte(0xA1,OLED_CMD); //段重定义设置,bit0:0,0->0;1,0->127;
    OLED_WR_Byte(0xC0,OLED_CMD); //设置COM扫描方向;bit3:0,普通模式;1,重定义模式 COM[N-1]->COM0;N:驱动路数
    OLED_WR_Byte(0xDA,OLED_CMD); //设置COM硬件引脚配置
    OLED_WR_Byte(0x12,OLED_CMD); //[5:4]配置

    OLED_WR_Byte(0x81,OLED_CMD); //对比度设置
    OLED_WR_Byte(0xEF,OLED_CMD); //1~255;默认0X7F (亮度设置,越大越亮)
    OLED_WR_Byte(0xD9,OLED_CMD); //设置预充电周期
    OLED_WR_Byte(0xf1,OLED_CMD); //[3:0],PHASE 1;[7:4],PHASE 2;
    OLED_WR_Byte(0xDB,OLED_CMD); //设置VCOMH 电压倍率
    OLED_WR_Byte(0x30,OLED_CMD); //[6:4] 000,0.65*vcc;001,0.77*vcc;011,0.83*vcc;

    OLED_WR_Byte(0xA4,OLED_CMD); //全局显示开启;bit0:1,开启;0,关闭;(白屏/黑屏)
    OLED_WR_Byte(0xA6,OLED_CMD); //设置显示方式;bit0:1,反相显示;0,正常显示
    OLED_WR_Byte(0xAF,OLED_CMD); //开启显示
    OLED_Clear();
}

//读点
//x:0~127
//y:0~63
uint8_t OLED_ReadPoint(uint8_t x,uint8_t y)
{
    uint8_t pos,bx,temp=0x00;
    //x = 127-x;
    y = 63-y;
    pos=y/8;
    bx=y%8;
    temp=1<<bx;
    if(temp&OLED_GRAM[x][pos]) return 1;
    return 0;
}

#define  LCD_WIDTH		128
#define  LCD_HIGH		64

const char* font1616_table =
{
    "矢量控制驱动板开发电池压流反势模式匀速度转矩扭位置环器版本号屏幕关于编码霍尔变换正弦"
};

const unsigned char font_1616[42][32]= {
0x00,0x81,0x02,0x81,0x04,0x82,0x18,0x82,0xF0,0x84,0x10,0x88,0x10,0xB0,0x1F,0xC0,
0x10,0xB0,0x10,0x88,0x10,0x84,0x10,0x82,0x10,0x82,0x00,0x81,0x00,0x81,0x00,0x00,/*"矢",0*/
0x04,0x00,0x04,0x01,0x04,0x01,0x7D,0xF5,0x55,0x55,0x55,0x55,0x55,0x55,0x55,0xFF,
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0x12,0x94,0x9C,0xA4,0x70,0xC4,0x10,0x84,0x13,0x14,0x10,0x0E,0x10,0x00,0x00,0x00,/*"弦",41*/

};

//显示一个指定大小的汉字
//x,y :汉字的坐标
//font:汉字GBK码
//f_w:字宽
//f_h:字高
//mode:0,正常显示,1,叠加显示
void show_font(uint16_t x,uint16_t y,const char *font,uint8_t f_w,uint8_t f_h,uint8_t mode)
{
    const char* font_table;
    uint16_t fontSeq;
    uint8_t temp,t,t1;
    uint16_t y0=y;
    uint8_t csize=(f_h/8+((f_h%8)?1:0))*f_w;//得到自由分辨字符所占的字节数

    if(f_w==16 && f_h==16)
        font_table = font1616_table;
    else return;/*没有的字库*/
    for(fontSeq=0; fontSeq<strlen(font_table)/2; fontSeq++)/*计算font_table对应字库的数组下标*/
    {
        if(font_table[2*fontSeq]==font[0] && font_table[2*fontSeq+1]==font[1])
            break;
    }
    if(fontSeq >= strlen(font_table)/2) return;/*font_table中没有font该字*/

    for(t=0; t<csize; t++)
    {
        if(f_w==16 && f_h==16)
            temp = font_1616[fontSeq][t];/*调用font_1616字库*/
        for(t1=0; t1<8; t1++)
        {
            if(temp&0x80)OLED_DrawPoint(x,y,mode);
            else OLED_DrawPoint(x,y,!mode);
            temp<<=1;
            y++;
            if((y-y0)==f_h)
            {
                y=y0;
                x++;
                break;
            }
        }
    }
}

//在指定位置开始显示一个字符串
//支持自动换行
//(x,y):起始坐标
//width,height:区域
//str  :字符串
//f_w:字宽
//f_h:字高
//mode:0,非叠加方式;1,叠加方式
void show_str(uint16_t x,uint16_t y,const char *str,uint8_t f_h,uint8_t mode)
{
    uint16_t x0=x;
    uint16_t y0=y;
    uint8_t bHz=0;     //字符或者中文
    while(*str!=0)//数据未结束
    {
        if(!bHz)
        {
            if(*str>0x80)bHz=1;//中文
            else               //字符
            {
                if(x>(x0+LCD_WIDTH-f_h/2))//换行
                {
                    y+=f_h;
                    x=x0;
                }
                if(y>(y0+LCD_HIGH-f_h))break;//越界返回
                if(*str==13)//换行符号
                {
                    y+=f_h;
                    x=x0;
                    str++;
                }
                else OLED_ShowChar(x,y,*str,f_h,mode);//有效部分写入
                str++;
                x+=f_h/2; //字符,为全字的一半
            }
        } else//中文
        {
            bHz=0;//有汉字库
            if(x>(x0+LCD_WIDTH-f_h))//换行
            {
                y+=f_h+2;//2为行间距
                x=x0;
            }
            if(y>(y0+LCD_HIGH-f_h))break;//越界返回
            show_font(x,y,str,f_h,f_h,mode); //显示这个汉字,空心显示
            str+=2;
            x+=f_h;//下一个汉字偏移
        }
    }
}
//在指定宽度的中间显示字符串
//如果字符长度超过了len,则用Show_Str显示
//len:指定要显示的宽度
void show_str_mid(uint16_t x,uint16_t y,const char *str,uint8_t f_h,uint8_t mode,uint16_t len)
{
    uint16_t strlenth=0;
    strlenth=strlen((char*)str);
    strlenth*=f_h/2;
    if(strlenth>len)show_str(x,y,str,f_h,mode);
    else
    {
        strlenth=(len-strlenth)/2;
        show_str(strlenth+x,y,str,f_h,mode);
    }
}

//10*16==宽*高  电量.bmp*13
const unsigned char bmp_battery[13][20]=
{
    {0x3F,0xFF,0x20,0x01,0x20,0x01,0xE0,0x01,0x80,0x01,0x80,0x01,0xE0,0x01,0x20,0x01,0x20,0x01,0x3F,0xFF},/*0格电量.BMP*/
    {0x3F,0xFF,0x20,0x03,0x20,0x03,0xE0,0x03,0x80,0x03,0x80,0x03,0xE0,0x03,0x20,0x03,0x20,0x03,0x3F,0xFF},/*1格电量.BMP*/
    {0x3F,0xFF,0x20,0x07,0x20,0x07,0xE0,0x07,0x80,0x07,0x80,0x07,0xE0,0x07,0x20,0x07,0x20,0x07,0x3F,0xFF},/*2格电量.BMP*/
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    {0x3F,0xFF,0x3F,0xFF,0x3F,0xFF,0xFF,0xFF,0x9F,0xFF,0x9F,0xFF,0xFF,0xFF,0x3F,0xFF,0x3F,0xFF,0x3F,0xFF},/*12格电量.BMP*/
};

//显示图片
//x,y:起点坐标
//p_w:图片宽（单位像素）
//p_h:图片高（单位像素）
//*p:图片起始地址
void oled_showPicture(uint8_t x,uint8_t y,const char *p,uint8_t p_w,uint8_t p_h)
{
    uint8_t temp,i,col,row;
    uint8_t y0=y;
    uint8_t width=p_w;
    if(x+p_w>128)width=128-p_w;//实际显示宽度
    uint8_t high=p_h;
    if(y+p_h>64)high=64-p_h;//实际显示高度
    uint8_t exp_col_bytes=(p_h/8+((p_h%8)?1:0));//显示一列的字节数
    uint8_t act_col_bytes=(high/8+((high%8)?1:0));//实际显示一列的字节数

    for(row=0; row<width; row++) //列++
    {
        for(col=0; col<act_col_bytes; col++) //显示一列
        {
            temp = p[col+row*exp_col_bytes];
            for(i=0; i<8; i++)
            {
                if(temp&0x80)OLED_DrawPoint(x,y,1);
                else OLED_DrawPoint(x,y,0);
                temp<<=1;
                y++;
                if((y-y0)==high)
                {
                    y=y0;
                    x++;
                    break;
                }
            }
        }
    }
}
